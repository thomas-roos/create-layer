## conf/layer.conf
```bitbake
# We have a conf and classes directory, add to BBPATH
BBPATH .= ":${LAYERDIR}"

# We have recipes-* directories, add to BBFILES
BBFILES += "${LAYERDIR}/recipes-*/*/*.bb \
            ${LAYERDIR}/recipes-*/*/*.bbappend"

BBFILE_COLLECTIONS += "testlayer"
BBFILE_PATTERN_testlayer = "^${LAYERDIR}/"
BBFILE_PRIORITY_testlayer = "6"

LAYERDEPENDS_testlayer = "core"
LAYERSERIES_COMPAT_testlayer = "mickledore"
```
